## CMakeLists.txt
```
# SPDX-License-Identifier: Apache-2.0

cmake_minimum_required(VERSION 3.20.0)

find_package(Zephyr REQUIRED HINTS $ENV{ZEPHYR_BASE})
project(udp_streaming)

target_sources(app PRIVATE src/main.c)
target_include_directories(app PRIVATE include)

zephyr_code_relocate(LIBRARY app LOCATION ITCM_TEXT_RODATA)
zephyr_code_relocate(LIBRARY subsys__rtio LOCATION ITCM_TEXT_RODATA)
zephyr_code_relocate(LIBRARY drivers__spi LOCATION ITCM_TEXT_RODATA)
zephyr_code_relocate(LIBRARY drivers__sensor__tdk__icm4268x LOCATION ITCM_TEXT_RODATA)

zephyr_code_relocate(LIBRARY subsys__net LOCATION ITCM_TEXT_RODATA)
zephyr_code_relocate(LIBRARY drivers__ethernet LOCATION ITCM_TEXT_RODATA)

zephyr_code_relocate(LIBRARY app LOCATION DTCM_DATA_BSS)
zephyr_code_relocate(LIBRARY subsys__rtio LOCATION DTCM_DATA_BSS)
zephyr_code_relocate(LIBRARY drivers__spi LOCATION DTCM_DATA_BSS)
zephyr_code_relocate(LIBRARY drivers__sensor__tdk__icm4268x LOCATION DTCM_DATA_BSS)
zephyr_code_relocate(LIBRARY kernel LOCATION DTCM_DATA_BSS)

zephyr_code_relocate(LIBRARY subsys__net LOCATION DTCM_DATA_BSS)
zephyr_code_relocate(LIBRARY drivers__ethernet LOCATION DTCM_DATA_BSS)
```

## prj.conf
```kconfig
# Sensor options
CONFIG_SENSOR=y
CONFIG_SENSOR_ASYNC_API=y
CONFIG_SPI_RTIO=y
CONFIG_LOG=y
CONFIG_ASSERT=y

# Generic networking options
CONFIG_NETWORKING=y
CONFIG_NET_UDP=y
CONFIG_NET_TCP=y
CONFIG_NET_IPV6=y
CONFIG_NET_IPV4=y
CONFIG_NET_SOCKETS=y
CONFIG_ZVFS_POLL_MAX=5
CONFIG_NET_CONNECTION_MANAGER=y
CONFIG_NET_SHELL=y
CONFIG_NET_CONFIG_SETTINGS=y
CONFIG_NET_CONFIG_NEED_IPV4=y

# Set these two IP Addresses
CONFIG_NET_CONFIG_MY_IPV4_ADDR=""
CONFIG_NET_CONFIG_PEER_IPV4_ADDR=""

CONFIG_POSIX_API=y

# Network buffers
CONFIG_NET_PKT_RX_COUNT=16
CONFIG_NET_PKT_TX_COUNT=32
CONFIG_NET_BUF_RX_COUNT=80
CONFIG_NET_BUF_TX_COUNT=80
CONFIG_NET_CONTEXT_NET_PKT_POOL=y
CONFIG_NET_BUF_DATA_SIZE=1024

# IP address options
CONFIG_NET_IF_UNICAST_IPV6_ADDR_COUNT=3
CONFIG_NET_IF_MCAST_IPV6_ADDR_COUNT=4
CONFIG_NET_MAX_CONTEXTS=10
CONFIG_NET_IF_MAX_IPV6_COUNT=3
CONFIG_NET_IF_MAX_IPV4_COUNT=3

# Performance config options
CONFIG_SYSTEM_WORKQUEUE_PRIORITY=1
CONFIG_SYSTEM_WORKQUEUE_STACK_SIZE=2048
CONFIG_SYS_CLOCK_TICKS_PER_SEC=100000
CONFIG_TICKLESS_KERNEL=y
CONFIG_RTIO_WORKQ_POOL_ITEMS=32
CONFIG_RTIO_WORKQ_THREADS_POOL=3

# Utilities to measure system perfromance
CONFIG_THREAD_ANALYZER=y
CONFIG_CPU_LOAD=y
CONFIG_CPU_LOAD_LOG_PERIODICALLY=5000

CONFIG_SPEED_OPTIMIZATIONS=y
```

## boards/mr_mcxn_t1_mcxn947_cpu0.conf
```kconfig
CONFIG_ICM4268X_STREAM=y
CONFIG_ICM45686_STREAM=y
CONFIG_TEST_RANDOM_GENERATOR=y
```

## boards/vmu_rt1170_mimxrt1176_cm7.conf
```kconfig
CONFIG_ICM4268X_STREAM=y
CONFIG_CODE_DATA_RELOCATION=y
```

## boards/mr_mcxn_t1_mcxn947_cpu0.overlay
```dts
#include <zephyr/dt-bindings/sensor/icm45686.h>

sensor_1: &icm45686_0 {
	accel-odr = <ICM45686_DT_GYRO_ODR_3200>;
	gyro-odr = <ICM45686_DT_GYRO_ODR_3200>;
	fifo-watermark = <4>;
};

sensor_0: &icm45686_1 {
	accel-odr = <ICM45686_DT_GYRO_ODR_3200>;
	gyro-odr = <ICM45686_DT_GYRO_ODR_3200>;
	fifo-watermark = <4>;
};
```

## boards/vmu_rt1170_mimxrt1176_cm7.overlay
```dts
#include <zephyr/dt-bindings/sensor/icm42686.h>

sensor_0: &icm42686_0 {
	accel-odr = <ICM42688_DT_ACCEL_ODR_32000>;
	gyro-odr = <ICM42688_DT_ACCEL_ODR_32000>;
};

#include <zephyr/dt-bindings/sensor/icm42688.h>

sensor_1: &icm42688_0 {
	accel-odr = <ICM42688_DT_ACCEL_ODR_32000>;
	gyro-odr = <ICM42688_DT_GYRO_ODR_32000>;
};
```

## src/main.c
```c
#include <zephyr/kernel.h>
#include <zephyr/drivers/sensor.h>
#include <zephyr/net/socket.h>

SENSOR_DT_STREAM_IODEV(sensor_iodev_0, DT_NODELABEL(sensor_0),
		       {SENSOR_TRIG_FIFO_WATERMARK, SENSOR_STREAM_DATA_INCLUDE});
SENSOR_DT_STREAM_IODEV(sensor_iodev_1, DT_NODELABEL(sensor_1),
		       {SENSOR_TRIG_FIFO_WATERMARK, SENSOR_STREAM_DATA_INCLUDE});
RTIO_DEFINE_WITH_MEMPOOL(sensor_ctx_1, 2, 64, 128, 128, sizeof(void *));
RTIO_DEFINE_WITH_MEMPOOL(sensor_ctx_0, 2, 64, 128, 128, sizeof(void *));

struct recover_dev {
	bool recover;
	struct rtio_iodev *iodev;
} recover_devs[] = {
	{.iodev = &sensor_iodev_0},
	{.iodev = &sensor_iodev_1},
};

static inline bool *get_recovery_bool(struct rtio_iodev *iodev)
{
	for (size_t i = 0 ; i < ARRAY_SIZE(recover_devs) ; i++) {
		if (iodev == recover_devs[i].iodev) {
			return &recover_devs[i].recover;
		}
	}
	return NULL;
}

#define PEER_PORT 33105

struct sample_data {
	const char *proto;

	struct {
		int sock;
		uint32_t expecting;
		uint32_t counter;
		uint32_t mtu;
		struct udp_control *ctrl;
	} udp;

	struct {
		int sock;
		uint32_t expecting;
		uint32_t received;
		uint32_t counter;
	} tcp;
};

struct configs {
	struct sample_data ipv4;
	struct sample_data ipv6;
} conf;

static int start_udp_proto(struct sample_data *data, sa_family_t family,
			   struct sockaddr *addr, socklen_t addrlen)
{
	data->udp.sock = socket(family, SOCK_DGRAM, IPPROTO_UDP);
	if (data->udp.sock < 0) {
		return -EINVAL;
	}

	return connect(data->udp.sock, addr, addrlen);
}

int start_udp(void)
{
	struct sockaddr_in addr4;

	addr4.sin_family = AF_INET;
	addr4.sin_port = htons(PEER_PORT);
	inet_pton(AF_INET, CONFIG_NET_CONFIG_PEER_IPV4_ADDR, &addr4.sin_addr);

	return start_udp_proto(&conf.ipv4, AF_INET, (struct sockaddr *)&addr4, sizeof(addr4));
}

static int setup_stream(struct rtio *ctx, struct rtio_iodev *iodev)
{
	uint64_t period_ticks = (uint64_t)CONFIG_SYS_CLOCK_TICKS_PER_SEC * 625 / 1000 / 1000;
	struct sensor_value ticks_per_event = {
		.val1 = period_ticks,
	};
	struct sensor_read_config *read_config =
		(struct sensor_read_config *)iodev->data;
	int err;

	printk("setting up stream...\n");

	(void)sensor_attr_set(read_config->sensor, SENSOR_CHAN_ALL,
				SENSOR_ATTR_BATCH_DURATION, &ticks_per_event);

	err = sensor_stream(iodev, ctx, (void *)iodev, NULL);
	if (err != 0) {
		printk("Failed to start sensor stream: %d\n", err);
		return err;
	}

	return 0;
}

static inline void avg_3_axis_q31(const struct sensor_three_axis_data *data, size_t count,
				  struct sensor_three_axis_data *out)
{
	int64_t avg[3] = {0};

	for (size_t i = 0 ; i < count ; i++) {
		avg[0] += data->readings[i].x;
		avg[1] += data->readings[i].y;
		avg[2] += data->readings[i].z;
	}
	avg[0] /= count;
	avg[1] /= count;
	avg[2] /= count;

	out->header.base_timestamp_ns = data->header.base_timestamp_ns;
	out->header.reading_count = 1;
	out->shift = data->shift;
	out->readings[0].x = avg[0];
	out->readings[0].y = avg[1];
	out->readings[0].z = avg[2];
}

static void process_events(int result, uint8_t *buf, uint32_t len, void *userdata)
{
	struct rtio_iodev *iodev = (struct rtio_iodev *)userdata;
	struct sensor_read_config *read_config = (struct sensor_read_config *)iodev->data;
	const struct device *sensor = read_config->sensor;
	const struct sensor_decoder_api *decoder;
	uint32_t dec_buf_size = sizeof(struct sensor_three_axis_data) +
				(256 - 1) * sizeof(struct sensor_three_axis_sample_data);
	uint8_t decoded_buffer[dec_buf_size];
	uint16_t frame_count;
	struct sensor_three_axis_data average_data[2];
	static atomic_t seq_ct = 0;
	int ret;

	uint32_t current_count = atomic_inc(&seq_ct);

	if (result < 0) {
		printk("recover: %d\n", result);

		bool *recovery = get_recovery_bool(iodev);
		*recovery = true;
		return;
	}

	ret = sensor_get_decoder(sensor, &decoder);
	__ASSERT_NO_MSG(ret == 0);

	{
		struct sensor_three_axis_data *dec_data =
			(struct sensor_three_axis_data *)decoded_buffer;
		uint32_t fit = 0;

		ret = decoder->get_frame_count(
			buf, (struct sensor_chan_spec) {SENSOR_CHAN_ACCEL_XYZ, 0}, &frame_count);
		__ASSERT_NO_MSG(ret >= 0);

		ret = decoder->decode(buf, (struct sensor_chan_spec) {SENSOR_CHAN_ACCEL_XYZ, 0},
				      &fit, 256, decoded_buffer);
		__ASSERT_NO_MSG(ret >= 0);

		avg_3_axis_q31(dec_data, ret, &average_data[0]);
	}
	{
		struct sensor_three_axis_data *dec_data =
			(struct sensor_three_axis_data *)decoded_buffer;
		uint32_t fit = 0;

		ret = decoder->get_frame_count(
			buf, (struct sensor_chan_spec) {SENSOR_CHAN_GYRO_XYZ, 0}, &frame_count);
		__ASSERT_NO_MSG(ret >= 0);
		ret = decoder->decode(buf, (struct sensor_chan_spec) {SENSOR_CHAN_GYRO_XYZ, 0},
				      &fit, 256, decoded_buffer);
		__ASSERT_NO_MSG(ret >= 0);

		avg_3_axis_q31(dec_data, ret, &average_data[1]);
	}

	char net_buffer[1024] = {0};

	int net_len =  snprintk(net_buffer, sizeof(net_buffer),
				"%d, %d, %s,"
				" %" PRIq(6) ", %" PRIq(6) ", %" PRIq(6) " ,"
				" %" PRIq(6) ", %" PRIq(6) ", %" PRIq(6) " , "
				"%lluns\n", current_count, ret, sensor->name,
				PRIq_arg(average_data[0].readings[0].x, 6, average_data[0].shift),
				PRIq_arg(average_data[0].readings[0].y, 6, average_data[0].shift),
				PRIq_arg(average_data[0].readings[0].z, 6, average_data[0].shift),
				PRIq_arg(average_data[1].readings[0].x, 6, average_data[1].shift),
				PRIq_arg(average_data[1].readings[0].y, 6, average_data[1].shift),
				PRIq_arg(average_data[1].readings[0].z, 6, average_data[1].shift),
				average_data[0].header.base_timestamp_ns);

	ssize_t err = send(conf.ipv4.udp.sock, net_buffer, net_len, 0);
	__ASSERT_NO_MSG(err >= 0);
}

static void sensor_processing_thread(void *arg1, void *arg2)
{
	struct rtio *ctx = (struct rtio *)arg1;
	struct rtio_iodev *iodev = (struct rtio_iodev *)arg2;
	int err;
	bool *recovery = get_recovery_bool(iodev);

	err = setup_stream(ctx, iodev);
	__ASSERT_NO_MSG(err == 0);

	printk("Starting main-loop: %p, %p\n", ctx, iodev);
	while (true) {
		sensor_processing_with_callback(ctx, process_events);
		if (*recovery) {
			*recovery = false;
			printk("Error during stream. Attempting recovery...\n");
			rtio_sqe_drop_all(ctx);
			k_sleep(K_MSEC(1));
			err = setup_stream(ctx, iodev);
			__ASSERT_NO_MSG(err == 0);
		}
	}
}

K_THREAD_DEFINE(sensor_stream_0_id, 8192, sensor_processing_thread,
		&sensor_ctx_0, &sensor_iodev_0, NULL, 8, 0, -1);
K_THREAD_DEFINE(sensor_stream_1_id, 8192, sensor_processing_thread,
		&sensor_ctx_1, &sensor_iodev_1, NULL, 8, 0, -1);

int main(void)
{
	int err;

	err = start_udp();
	__ASSERT_NO_MSG(err == 0);

	printk("Starting main-loop\n");

	k_thread_start(sensor_stream_0_id);
	k_thread_start(sensor_stream_1_id);

	return 0;
}
```
