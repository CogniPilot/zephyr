## CMakeLists.txt
```
# SPDX-License-Identifier: Apache-2.0

cmake_minimum_required(VERSION 3.20.0)
find_package(Zephyr REQUIRED HINTS $ENV{ZEPHYR_BASE})
project(dshot)

target_sources(app PRIVATE src/main.c)
```

## sample.yaml
```
sample:
  name: NXP Flexio Dshot sample
```

## prj.conf
```kconfig
CONFIG_NXP_FLEXIO_DSHOT=y
```

## boards/vmu_rt1170_mimxrt1176_cm7.overlay
```dts
&flexpwm1_pwm0 {
	status = "disabled";
};
```

## src/main.c
```c
/*
 * Copyright (c) 2024 Peter van der Perk <peter.vanderperk@nxp.com>
 *
 * SPDX-License-Identifier: Apache-2.0
 */

#include <zephyr/kernel.h>

/**
 * @file Output dshot
 */

int main(void)
{
	const struct device *const dev = DEVICE_DT_GET(DT_NODELABEL(flexio0_dshot));
	int erpm;

	nxp_flexio_dshot_data_set(dev, 0, 0x0, false);

	while (1) {
		nxp_flexio_dshot_trigger(dev);
		k_sleep(K_MSEC(500));
		if (up_bdshot_get_erpm(dev, 0, &erpm)) {
			printf("ERPM %i\n", erpm);
		}
	}

	return 0;
}
```
