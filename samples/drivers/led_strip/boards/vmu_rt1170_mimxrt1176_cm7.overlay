/*
 * Copyright (c) 2024 CogniPilot Foundation.
 *
 * SPDX-License-Identifier: Apache-2.0
 */

#include <zephyr/dt-bindings/led/led.h>

&lpspi6 {
	status = "okay";
	sk9822: sk9822@0 {
		compatible = "opsco,sk9822";
		reg = <0>;
		spi-max-frequency = <4000000>;
		status = "okay";
	};
};

/ {
	aliases {
		led-strip = &sk9822;
	};
};
