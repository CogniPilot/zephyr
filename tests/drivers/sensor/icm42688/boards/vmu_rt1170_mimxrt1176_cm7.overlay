/* SPDX-License-Identifier: Apache-2.0 */
/* Copyright 2023 CogniPilot Foundation */

&lpspi1 {
	/delete-node/ icm42688p0@0;
	/delete-property/ dmas;
	/delete-property/ dma-names;
};

&lpspi2 {
	icm42688_1: icm42688p1@0 {
		fifo-hires;
	};
};
