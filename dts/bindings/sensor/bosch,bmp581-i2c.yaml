## samples/subsys/fs/fs_sample/boards/vmu_rt1170.conf
```kconfig
# If not set to Immediate and logging on fails to mount sdcard
CONFIG_LOG_MODE_IMMEDIATE=y
CONFIG_DISK_DRIVER_SDMMC=y
```

## samples/subsys/ipc/openamp_rsc_table/boards/imx95_evk_mimx9596_m7.conf
```kconfig
CONFIG_CLOCK_CONTROL=y
CONFIG_LOG=y
CONFIG_CONSOLE=y
CONFIG_OPENAMP_WITH_DCACHE=y
CONFIG_UART_CONSOLE=y
CONFIG_ARM_SCMI=y
CONFIG_IPM_MBOX=y
CONFIG_MBOX_NXP_IMX_MU=y
CONFIG_MBOX_INIT_PRIORITY=0
CONFIG_LOG_MODE_MINIMAL=y
CONFIG_LOG_DEFAULT_LEVEL=0
CONFIG_OPENAMP_COPY_RSC_TABLE=y
CONFIG_KERNEL_BIN_NAME="zephyr"
CONFIG_PRINTK=y
CONFIG_FILE_SYSTEM=y
CONFIG_FILE_SYSTEM_RPMSGFS=y
CONFIG_FILE_SYSTEM_SHELL=y
CONFIG_FILE_SYSTEM_SHELL_TEST_COMMANDS=y
```

## tests/drivers/sensor/icm42688/Kconfig
```kconfig
# Copyright (c) 2020 Erwin Rol <erwin@erwinrol.com>
# SPDX-License-Identifier: Apache-2.0

mainmenu "ICM42688 Test"

source "Kconfig.zephyr"

config ICM42688_TEST_EMUL
	bool "run emulation test"
```

## tests/net/socket/socketpair/testcase.yaml
```yaml
common:
  tags:
    - net
    - socket
    - userspace
  depends_on: netif
  min_ram: 21
tests:
  net.socket.socketpair: {}
  net.socket.socketpair.newlib:
    filter: TOOLCHAIN_HAS_NEWLIB == 1
    extra_configs:
      - CONFIG_NEWLIB_LIBC=y
    platform_exclude: vmu_rt1170 # See #61246
  net.socket.socketpair.picolibc:
    filter: CONFIG_PICOLIBC_SUPPORTED
    extra_configs:
      - CONFIG_PICOLIBC=y
    platform_exclude: vmu_rt1170 # See #61246
```
