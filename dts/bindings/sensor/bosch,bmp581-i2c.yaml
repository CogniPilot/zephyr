## dts/bindings/sensor/invensense,icm4268x.yaml
```yaml
# Copyright (c) 2025 Croxel, Inc.
# SPDX-License-Identifier: Apache-2.0

compatible: "invensense,icm4268x"
include: [sensor-device.yaml, spi-device.yaml]

properties:
  int-gpios:
    type: phandle-array
    description: |
      The INT signal default configuration is active-high. The
      property value should ensure the flags properly describe the
      signal that is presented to the driver.

  accel-pwr-mode:
    type: int
    default: 0
    description: |
      Specify the default accelerometer power mode.
      Default is power-up configuration.
    enum:
      - 0 # ICM4268X_DT_ACCEL_OFF
      - 2 # ICM4268X_DT_ACCEL_LP
      - 3 # ICM4268X_DT_ACCEL_LN

  accel-odr:
    type: int
    default: 6
    description: |
      Specify the default accelerometer output data rate expressed in samples per second (Hz).
      Default is power-up configuration.
    enum:
      - 1  # ICM4268X_DT_ACCEL_ODR_32000
      - 2  # ICM4268X_DT_ACCEL_ODR_16000
      - 3  # ICM4268X_DT_ACCEL_ODR_8000
      - 4  # ICM4268X_DT_ACCEL_ODR_4000
      - 5  # ICM4268X_DT_ACCEL_ODR_2000
      - 6  # ICM4268X_DT_ACCEL_ODR_1000
      - 7  # ICM4268X_DT_ACCEL_ODR_200
      - 8  # ICM4268X_DT_ACCEL_ODR_100
      - 9  # ICM4268X_DT_ACCEL_ODR_50
      - 10 # ICM4268X_DT_ACCEL_ODR_25
      - 11 # ICM4268X_DT_ACCEL_ODR_12_5
      - 12 # ICM4268X_DT_ACCEL_ODR_6_25
      - 13 # ICM4268X_DT_ACCEL_ODR_3_125
      - 14 # ICM4268X_DT_ACCEL_ODR_1_5625
      - 15 # ICM4268X_DT_ACCEL_ODR_500

  accel-fs:
    type: int
    default: 0
    description: |
      Specify the accelerometer range in g.
      Default is power-up configuration.
    enum:
      - 0 # ICM42686_DT_ACCEL_FS_32 | ICM42688_DT_ACCEL_FS_16
      - 1 # ICM42686_DT_ACCEL_FS_16 | ICM42688_DT_ACCEL_FS_8
      - 2 # ICM42686_DT_ACCEL_FS_8  | ICM42688_DT_ACCEL_FS_4
      - 3 # ICM42686_DT_ACCEL_FS_4  | ICM42688_DT_ACCEL_FS_2
      - 4 # ICM42686_DT_ACCEL_FS_2

  gyro-pwr-mode:
    type: int
    default: 0
    description: |
      Specify the default gyro power mode.
      Default is power-up configuration.
    enum:
      - 0 # ICM4268X_DT_GYRO_OFF
      - 1 # ICM4268X_DT_GYRO_STANDBY
      - 3 # ICM4268X_DT_GYRO_LN

  gyro-odr:
    type: int
    default: 6
    description: |
      Specify the default gyro output data rate expressed in samples per second (Hz).
      Default is power-up configuration.
    enum:
      - 1  # ICM4268X_DT_GYRO_ODR_32000
      - 2  # ICM4268X_DT_GYRO_ODR_16000
      - 3  # ICM4268X_DT_GYRO_ODR_8000
      - 4  # ICM4268X_DT_GYRO_ODR_4000
      - 5  # ICM4268X_DT_GYRO_ODR_2000
      - 6  # ICM4268X_DT_GYRO_ODR_1000
      - 7  # ICM4268X_DT_GYRO_ODR_200
      - 8  # ICM4268X_DT_GYRO_ODR_100
      - 9  # ICM4268X_DT_GYRO_ODR_50
      - 10 # ICM4268X_DT_GYRO_ODR_25
      - 11 # ICM4268X_DT_GYRO_ODR_12_5
      - 15 # ICM4268X_DT_GYRO_ODR_500

  gyro-fs:
    type: int
    default: 0
    description: |
      Specify the gyro range in degrees per second.
      Default is power-up configuration.
    enum:
      - 0 # ICM42686_DT_GYRO_FS_4000  | ICM42688_DT_GYRO_FS_2000
      - 1 # ICM42686_DT_GYRO_FS_2000  | ICM42688_DT_GYRO_FS_1000
      - 2 # ICM42686_DT_GYRO_FS_1000  | ICM42688_DT_GYRO_FS_500
      - 3 # ICM42686_DT_GYRO_FS_500   | ICM42688_DT_GYRO_FS_250
      - 4 # ICM42686_DT_GYRO_FS_250   | ICM42688_DT_GYRO_FS_125
      - 5 # ICM42686_DT_GYRO_FS_125   | ICM42688_DT_GYRO_FS_62_5
      - 6 # ICM42686_DT_GYRO_FS_62_5  | ICM42688_DT_GYRO_FS_31_25
      - 7 # ICM42686_DT_GYRO_FS_31_25 | ICM42688_DT_GYRO_FS_15_625

  fifo-hires:
    type: boolean
    description: |
      Enables hires for fifo

  accel-filt-bw:
    type: int
    default: 0
    description: |
      Specify the accelerometer UI filter bandwidth.
      Default is ODR/2 (maximum bandwidth, lowest latency).
      See datasheet section 5.3 for filter response details.
    enum:
      - 0   # ICM4268X_DT_ACCEL_FILT_BW_ODR_DIV_2 (default, max BW)
      - 1   # ICM4268X_DT_ACCEL_FILT_BW_MAX_400_ODR_DIV_4
      - 2   # ICM4268X_DT_ACCEL_FILT_BW_MAX_400_ODR_DIV_5
      - 3   # ICM4268X_DT_ACCEL_FILT_BW_MAX_400_ODR_DIV_8
      - 4   # ICM4268X_DT_ACCEL_FILT_BW_MAX_400_ODR_DIV_10
      - 5   # ICM4268X_DT_ACCEL_FILT_BW_MAX_400_ODR_DIV_16
      - 6   # ICM4268X_DT_ACCEL_FILT_BW_MAX_400_ODR_DIV_20
      - 7   # ICM4268X_DT_ACCEL_FILT_BW_MAX_400_ODR_DIV_40
      - 14  # ICM4268X_DT_ACCEL_FILT_BW_LOW_LATENCY (low latency mode, max 400Hz BW)
      - 15  # ICM4268X_DT_ACCEL_FILT_BW_LOW_LATENCY_8X (low latency, max 200Hz, 8x ODR dec)

  accel-filt-ord:
    type: int
    default: 0
    description: |
      Specify the accelerometer UI filter order.
      Higher order provides steeper roll-off but more latency.
      Default is 1st order.
    enum:
      - 0  # ICM4268X_DT_ACCEL_FILT_ORDER_1 (1st order)
      - 1  # ICM4268X_DT_ACCEL_FILT_ORDER_2 (2nd order)
      - 2  # ICM4268X_DT_ACCEL_FILT_ORDER_3 (3rd order)

  gyro-filt-bw:
    type: int
    default: 0
    description: |
      Specify the gyroscope UI filter bandwidth.
      Default is ODR/2 (maximum bandwidth, lowest latency).
      See datasheet section 5.3 for filter response details.
    enum:
      - 0   # ICM4268X_DT_GYRO_FILT_BW_ODR_DIV_2 (default, max BW)
      - 1   # ICM4268X_DT_GYRO_FILT_BW_MAX_400_ODR_DIV_4
      - 2   # ICM4268X_DT_GYRO_FILT_BW_MAX_400_ODR_DIV_5
      - 3   # ICM4268X_DT_GYRO_FILT_BW_MAX_400_ODR_DIV_8
      - 4   # ICM4268X_DT_GYRO_FILT_BW_MAX_400_ODR_DIV_10
      - 5   # ICM4268X_DT_GYRO_FILT_BW_MAX_400_ODR_DIV_16
      - 6   # ICM4268X_DT_GYRO_FILT_BW_MAX_400_ODR_DIV_20
      - 7   # ICM4268X_DT_GYRO_FILT_BW_MAX_400_ODR_DIV_40
      - 14  # ICM4268X_DT_GYRO_FILT_BW_LOW_LATENCY (low latency mode, max 400Hz BW)
      - 15  # ICM4268X_DT_GYRO_FILT_BW_LOW_LATENCY_8X (low latency, max 200Hz, 8x ODR dec)

  gyro-filt-ord:
    type: int
    default: 0
    description: |
      Specify the gyroscope UI filter order.
      Higher order provides steeper roll-off but more latency.
      Default is 1st order.
    enum:
      - 0  # ICM4268X_DT_GYRO_FILT_ORDER_1 (1st order)
      - 1  # ICM4268X_DT_GYRO_FILT_ORDER_2 (2nd order)
      - 2  # ICM4268X_DT_GYRO_FILT_ORDER_3 (3rd order)

  accel-aaf:
    type: int
    default: 0
    description: |
      Specify the accelerometer anti-aliasing filter (AAF) 3dB cutoff frequency in Hz.
      The AAF is a hardware low-pass filter before the ADC that prevents aliasing.
      Value 0 disables the AAF. Default is disabled (AAF off).
      See datasheet section 5.2 for AAF response details.
    enum:
      - 0   # ICM4268X_DT_ACCEL_AAF_DIS (disabled)
      - 1   # ICM4268X_DT_ACCEL_AAF_42 (42 Hz)
      - 2   # ICM4268X_DT_ACCEL_AAF_84 (84 Hz)
      - 3   # ICM4268X_DT_ACCEL_AAF_126 (126 Hz)
      - 4   # ICM4268X_DT_ACCEL_AAF_170 (170 Hz)
      - 5   # ICM4268X_DT_ACCEL_AAF_213 (213 Hz)
      - 6   # ICM4268X_DT_ACCEL_AAF_258 (258 Hz)
      - 7   # ICM4268X_DT_ACCEL_AAF_303 (303 Hz)
      - 8   # ICM4268X_DT_ACCEL_AAF_348 (348 Hz)
      - 9   # ICM4268X_DT_ACCEL_AAF_394 (394 Hz)
      - 10  # ICM4268X_DT_ACCEL_AAF_441 (441 Hz)
      - 11  # ICM4268X_DT_ACCEL_AAF_488 (488 Hz)
      - 12  # ICM4268X_DT_ACCEL_AAF_536 (536 Hz)
      - 13  # ICM4268X_DT_ACCEL_AAF_585 (585 Hz)
      - 14  # ICM4268X_DT_ACCEL_AAF_634 (634 Hz)
      - 21  # ICM4268X_DT_ACCEL_AAF_997 (997 Hz)
      - 38  # ICM4268X_DT_ACCEL_AAF_2029 (2029 Hz)
      - 52  # ICM4268X_DT_ACCEL_AAF_3057 (3057 Hz)
      - 63  # ICM4268X_DT_ACCEL_AAF_3979 (3979 Hz)

  gyro-aaf:
    type: int
    default: 0
    description: |
      Specify the gyroscope anti-aliasing filter (AAF) 3dB cutoff frequency in Hz.
      The AAF is a hardware low-pass filter before the ADC that prevents aliasing.
      Value 0 disables the AAF. Default is disabled (AAF off).
      See datasheet section 5.2 for AAF response details.
    enum:
      - 0   # ICM4268X_DT_GYRO_AAF_DIS (disabled)
      - 1   # ICM4268X_DT_GYRO_AAF_42 (42 Hz)
      - 2   # ICM4268X_DT_GYRO_AAF_84 (84 Hz)
      - 3   # ICM4268X_DT_GYRO_AAF_126 (126 Hz)
      - 4   # ICM4268X_DT_GYRO_AAF_170 (170 Hz)
      - 5   # ICM4268X_DT_GYRO_AAF_213 (213 Hz)
      - 6   # ICM4268X_DT_GYRO_AAF_258 (258 Hz)
      - 7   # ICM4268X_DT_GYRO_AAF_303 (303 Hz)
      - 8   # ICM4268X_DT_GYRO_AAF_348 (348 Hz)
      - 9   # ICM4268X_DT_GYRO_AAF_394 (394 Hz)
      - 10  # ICM4268X_DT_GYRO_AAF_441 (441 Hz)
      - 11  # ICM4268X_DT_GYRO_AAF_488 (488 Hz)
      - 12  # ICM4268X_DT_GYRO_AAF_536 (536 Hz)
      - 13  # ICM4268X_DT_GYRO_AAF_585 (585 Hz)
      - 14  # ICM4268X_DT_GYRO_AAF_634 (634 Hz)
      - 21  # ICM4268X_DT_GYRO_AAF_997 (997 Hz)
      - 38  # ICM4268X_DT_GYRO_AAF_2029 (2029 Hz)
      - 52  # ICM4268X_DT_GYRO_AAF_3057 (3057 Hz)
      - 63  # ICM4268X_DT_GYRO_AAF_3979 (3979 Hz)

  interrupt1-drdy:
    type: boolean
    description: |
      Route the data ready interrupt to INT1 pin. When enabled, the sensor
      generates an interrupt on INT1 each time new sensor data is available.
      This enables low-latency DRDY-based streaming mode where data is read
      directly from sensor registers instead of FIFO.
```

## dts/bindings/sensor/nxp,mcux-qdec.yaml
```yaml
# Copyright (c) 2022, Prevas A/S
# SPDX-License-Identifier: Apache-2.0

description: NXP MCUX QDEC

compatible: "nxp,mcux-qdec"

include: [base.yaml, pinctrl-device.yaml, sensor-device.yaml]

properties:
  reg:
    required: true

  interrupts:
    required: true

  counts-per-revolution:
    type: int
    required: true
    description: |
      This is a number that is used to determine how many revolutions
      were done based on the current counter's value.

  single-phase-mode:
    type: boolean
    description: |
      Bypass the quadrature decoder. A positive transition of the PHASEA input
      generates a count signal. The PHASEB input and the REV bit control the
      counter direction.

  filter-count:
    type: int
    enum: [0, 1, 2, 3, 4, 5, 6, 7]
    description: |
      The number of consecutive samples that must agree prior to the input
      filter accepting an input transition. A value of 0 represents 3
      samples. A value of 7 represents 10 samples.

  filter-sample-period:
    type: int
    description: |
      The sampling period (in IPBus clock cycles) of the decoder input signals.
      Each input is sampled multiple times at the rate specified by the Filter
      Sample Period. If FILT_PER is 0 (default), then the input filter is
      bypassed. Bypassing the digital filter enables the position/position
      difference counters to operate with count rates up to the IPBus
      frequency. Turning on the input filter introduces a latency of:
      ((FILT_CNT + 3) * FILT_PER) FILT clock cycles + 2 IPBus clock periods.

  speed-measurement:
    type: boolean
    description: |
      Quadrature decoder hardware timer calculates the speed the IPBus clock
      and the POSDPER counter. Note: you've to provide the clocks entry as well.

  ipbus-prescaler:
    type: string
    description: |
      When speed-measurement is enablement the 16-bit period time register,
      is clocked by the IPBus. If your sampling rate is too low the 16-bit
      timer can overflow. To avoid this you can set prescaler to clock the
      timer at a lower rate.
    enum:
      - "kENC_ClockDiv1"
      - "kENC_ClockDiv2"
      - "kENC_ClockDiv4"
      - "kENC_ClockDiv8"
      - "kENC_ClockDiv16"
      - "kENC_ClockDiv32"
      - "kENC_ClockDiv64"
      - "kENC_ClockDiv128"
      - "kENC_ClockDiv256"
      - "kENC_ClockDiv512"
      - "kENC_ClockDiv1024"
      - "kENC_ClockDiv2048"
      - "kENC_ClockDiv4096"
      - "kENC_ClockDiv8192"
      - "kENC_ClockDiv16384"
      - "kENC_ClockDiv32768"


  xbar:
    type: phandle
    required: true
    description: |
      The xbar phandle.
```

## dts/bindings/sensor/nxp,tpm-qdec.yaml
```yaml
# Copyright (c) 2025 NXP
# SPDX-License-Identifier: Apache-2.0

description: |
  NXP Timer/PWM Module (TPM) Quadrature Decoder Mode driver.
  This driver uses tpm_chn0 (phase A) and tpm_chn1 (phase B) input signals to control the
  TPM counter increment and decrement. The Zephyr Sensor API exposes the rotational position as
  SENSOR_CHAN_ROTATION by dividing the counter by counts-per revolution definition.

  To use the NXP TPM module you've to override the compatible string to use the QDEC mode driver
  with 'nxp,tpm-qdec'

  &tpm4 {
        compatible = "nxp,tpm-qdec";
        status = "okay";
        pinctrl-0 = <&tpm4_pwm2_pwm3>;
        pinctrl-names = "default";
        counts-per-revolution = <1>;
   };

compatible: "nxp,tpm-qdec"

include: [pinctrl-device.yaml, sensor-device.yaml]

properties:
  reg:
    required: true

  interrupts:
    required: true

  counts-per-revolution:
    type: int
    required: true
    description: |
      This is a number that is used to determine how many revolutions
      were done based on the current counter's value.

  pinctrl-0:
    required: true

  prescaler:
    type: int
    default: 1
    enum:
      - 1
      - 2
      - 4
      - 8
      - 16
      - 32
      - 64
      - 128
    description: Input clock prescaler
```

## dts/bindings/sensor/pixart,paa3905.yaml
```yaml
# Copyright 2025 Croxel Inc.
# SPDX-License-Identifier: Apache-2.0

description: PA3905 optical flow sensor

compatible: "pixart,paa3905"

include: spi-device.yaml
```

## dts/bindings/sensor/sensor-axis-align.yaml
```yaml
# Copyright 2025 CogniPilot Foundation
# SPDX-License-Identifier: Apache-2.0

description: |
    Axis alignment specification for sensors
    that require orientation.

    Example:
    #include <zephyr/dt-bindings/sensor/icm42688.h>

    icm42688: icm42688@0 {
      ...
      axis-align-x = <ALIGN_NEG_X>
      accel-pwr-mode = <ICM42688_DT_ACCEL_LN>;
      accel-fs = <ICM42688_DT_ACCEL_FS_16>;
      accel-odr = <ICM42688_DT_ACCEL_ODR_2000>;
      gyro-pwr-mode= <ICM42688_DT_GYRO_LN>;
      gyro-fs = <ICM42688_DT_GYRO_FS_2000>;
      gyro-odr = <ICM42688_DT_GYRO_ODR_2000>;
    };

include: base.yaml
properties:
  axis-align-x:
    type: int
    default: 0
    description: |
      Align sensor chanel x output with hardware orientation axis.
      Defaults to x.
    enum:
      - 0 # SENSOR_AXIS_ALIGN_DT_X
      - 1 # SENSOR_AXIS_ALIGN_DT_Y
      - 2 # SENSOR_AXIS_ALIGN_DT_Z

  axis-align-x-sign:
    type: int
    default: 2
    description: |
      Align sensor chanel x output with hardware orientation axis sign component.
      Defaults to positive.
    enum:
      - 0 # SENSOR_AXIS_ALIGN_DT_NEG
      - 2 # SENSOR_AXIS_ALIGN_DT_POS
  
  axis-align-y:
    type: int
    default: 1
    description: |
      Align sensor chanel y output with hardware orientation axis.
      Defaults to y.
    enum:
      - 0 # SENSOR_AXIS_ALIGN_DT_X
      - 1 # SENSOR_AXIS_ALIGN_DT_Y
      - 2 # SENSOR_AXIS_ALIGN_DT_Z

  axis-align-y-sign:
    type: int
    default: 2
    description: |
      Align sensor chanel y output with hardware orientation axis sign component.
      Defaults to positive.
    enum:
      - 0 # SENSOR_AXIS_ALIGN_DT_NEG
      - 2 # SENSOR_AXIS_ALIGN_DT_POS
  
  axis-align-z:
    type: int
    default: 2
    description: |
      Align sensor chanel z output with hardware orientation axis.
      Defaults to z.
    enum:
      - 0 # SENSOR_AXIS_ALIGN_DT_X
      - 1 # SENSOR_AXIS_ALIGN_DT_Y
      - 2 # SENSOR_AXIS_ALIGN_DT_Z

  axis-align-z-sign:
    type: int
    default: 2
    description: |
      Align sensor chanel z output with hardware orientation axis sign component.
      Defaults to positive.
    enum:
      - 0 # SENSOR_AXIS_ALIGN_DT_NEG
      - 2 # SENSOR_AXIS_ALIGN_DT_POS
```

## samples/drivers/led_strip/boards/vmu_rt1170_mimxrt1176_cm7.conf
```kconfig
CONFIG_SAMPLE_LED_STRIP_LENGTH=36
CONFIG_SAMPLE_LED_UPDATE_DELAY=5
CONFIG_LED_STRIP=y
CONFIG_SK9822_STRIP=y
```
