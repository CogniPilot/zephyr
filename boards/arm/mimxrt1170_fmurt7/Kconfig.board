## boards/arm/mimxrt1170_fmurt7/Kconfig.board
```kconfig
# Copyright (c) 2021, NXP
# SPDX-License-Identifier: Apache-2.0

config BOARD_MIMXRT1170_FMURT7
	bool "NXP MIMXRT1170-FMURT7"
	depends on SOC_MIMXRT1176_CM7
	select SOC_PART_NUMBER_MIMXRT1176DVMAA
```

## boards/arm/mimxrt1170_fmurt7/Kconfig.defconfig
```kconfig
# MIMXRT1170-EVK board

# Copyright 2021,2023 NXP
# SPDX-License-Identifier: Apache-2.0

if BOARD_MIMXRT1170_FMURT7

config BOARD
	default "mimxrt1170_fmurt7" if BOARD_MIMXRT1170_FMURT7

choice CODE_LOCATION
	default CODE_FLEXSPI if BOARD_MIMXRT1170_FMURT7
endchoice

if DISK_DRIVERS

config IMX_USDHC_DAT3_PWR_TOGGLE
	default y

endif # DISK_DRIVERS

if FLASH

choice FLASH_MCUX_FLEXSPI_XIP_MEM_TARGET
	default FLASH_MCUX_FLEXSPI_XIP_MEM_ITCM if CPU_CORTEX_M7
	default FLASH_MCUX_FLEXSPI_XIP_MEM_SRAM if CPU_CORTEX_M4
endchoice

endif #FLASH

if NETWORKING

config NET_L2_ETHERNET
	default y if CPU_CORTEX_M7 # No cache memory support is required for driver

config ETH_MCUX_PHY_RESET
	default n

config ETH_MCUX_RMII_EXT_CLK
	default y

endif # NETWORKING


endif # BOARD_MIMXRT1170_FMURT7
```

## boards/nxp/mr_mcxn_t1/Kconfig
```kconfig
# Copyright 2025 NXP
# SPDX-License-Identifier: Apache-2.0

config BOARD_MR_MCXN_T1
	select BOARD_EARLY_INIT_HOOK
```

## boards/nxp/mr_mcxn_t1/Kconfig.defconfig
```kconfig
# Copyright 2025 NXP
# SPDX-License-Identifier: Apache-2.0

if BOARD_MR_MCXN_T1

config NET_L2_ETHERNET
	default y if NETWORKING

if SD_STACK

# SD stack requires larger main stack size
config MAIN_STACK_SIZE
	default 1536

endif

endif
```

## boards/nxp/mr_mcxn_t1/Kconfig.mr_mcxn_t1
```kconfig
# Copyright 2024 NXP
# SPDX-License-Identifier: Apache-2.0

config BOARD_MR_MCXN_T1
	select SOC_MCXN947_CPU0 if BOARD_MR_MCXN_T1_MCXN947_CPU0
	select SOC_MCXN947_CPU1 if BOARD_MR_MCXN_T1_MCXN947_CPU1
	select SOC_PART_NUMBER_MCXN947VDF
```

## boards/nxp/mr_mcxn_t1/board.yml
```yaml
board:
  name: mr_mcxn_t1
  full_name: FRDM-MCXN947
  vendor: nxp
  socs:
  - name: mcxn947
    variants:
    - name: qspi
      cpucluster: 'cpu0'
```

## boards/nxp/mr_navq95a/Kconfig.mr_navq95a
```kconfig
# Copyright 2025 NXP
# SPDX-License-Identifier: Apache-2.0

config BOARD_MR_NAVQ95A
	select SOC_MIMX9596_M7 if BOARD_MR_NAVQ95A_MIMX9596_M7 || BOARD_MR_NAVQ95A_MIMX9596_M7_DDR || BOARD_MR_NAVQ95A_MIMX9596_M7_FLASH
	select SOC_PART_NUMBER_MIMX9596AVZXN
```

## boards/nxp/mr_navq95a/board.yml
```yaml
board:
  name: mr_navq95a
  full_name: NXP MR-NavQ95A
  vendor: nxp
  socs:
  - name: mimx9596
    variants:
    - name: ddr
      cpucluster: m7
    - name: flash
      cpucluster: m7
```

## boards/nxp/mr_navq95a/mr_navq95a_mimx9596_m7_flash_defconfig
```kconfig
#
# Copyright 2025 NXP
#
# SPDX-License-Identifier: Apache-2.0
#

CONFIG_CLOCK_CONTROL=y
CONFIG_SERIAL=y
CONFIG_UART_CONSOLE=y
CONFIG_UART_INTERRUPT_DRIVEN=y
CONFIG_CONSOLE=y
CONFIG_XIP=y
CONFIG_MBOX=y
CONFIG_MBOX_INIT_PRIORITY=0
CONFIG_ARM_SCMI=y
CONFIG_ARM_SCMI_NXP_VENDOR_EXTENSIONS=y
CONFIG_I3C=y

CONFIG_BOOTLOADER_MCUBOOT=y
CONFIG_MCUBOOT_GENERATE_UNSIGNED_IMAGE=y
CONFIG_MCUBOOT_GENERATE_CONFIRMED_IMAGE=y
CONFIG_FLASH_BASE_ADDRESS=0x2000000
```

## boards/nxp/navq95/Kconfig.navq95
```kconfig
# Copyright 2024 NXP
# SPDX-License-Identifier: Apache-2.0

config BOARD_NAVQ95
	select SOC_MIMX9596_M7 if BOARD_NAVQ95_MIMX9596_M7 || BOARD_NAVQ95_MIMX9596_M7_DDR || BOARD_NAVQ95_MIMX9596_M7_FLASH
	select SOC_PART_NUMBER_MIMX9596AVZXN
```

## boards/nxp/navq95/board.yml
```yaml
board:
  name: navq95
  full_name: NavQ95
  vendor: nxp
  socs:
  - name: mimx9596
    variants:
    - name: ddr
      cpucluster: m7
    - name: flash
      cpucluster: m7
```

## boards/nxp/tropic/Kconfig.board
```kconfig
#
# Copyright (c) 2024, Peter van der Perk
#
# SPDX-License-Identifier: Apache-2.0
#

config BOARD_TROPIC
	select SOC_PART_NUMBER_MIMXRT1062DVL6A
```

## boards/nxp/tropic/Kconfig.defconfig
```kconfig
#
# Copyright (c) 2020, Bernhard Kraemer
# Copyright (c) 2024, Peter van der Perk
#
# SPDX-License-Identifier: Apache-2.0
#

if BOARD_TROPIC

config BUILD_OUTPUT_HEX
	bool
	default y

config DISK_DRIVER_SDMMC
	default y if DISK_DRIVERS

endif # BOARD_TROPIC
```

## boards/shields/mr_canhubk3_adap/Kconfig.shield
```kconfig
# Copyright (c) 2023 CogniPilot Foundation
# Copyright (c) 2023 NXP
# SPDX-License-Identifier: Apache-2.0

config SHIELD_MR_CANHUBK3_ADAP
	def_bool $(shields_list_contains,mr_canhubk3_adap)
```

## drivers/input/Kconfig.sbus
```kconfig
# Copyright (c) 2023 Antmicro <www.antmicro.com>
# SPDX-License-Identifier: Apache-2.0

config INPUT_SBUS
	bool "SBUS driver"
	default y
	depends on DT_HAS_FUTABA_SBUS_ENABLED
	depends on UART_INTERRUPT_DRIVEN
	select UART_USE_RUNTIME_CONFIGURE
	help
	  Enable driver for SBUS Remote controller.


if INPUT_SBUS

config INPUT_SBUS_THREAD_STACK_SIZE
	int "Stack size for the ppm thread"
	default 1024
	help
	  Size of the stack used for the ppm thread.

config INPUT_SBUS_REPORT_FILTER
	int "Minimal change in signal to report"
	default 1
	help
	  SBUS tends to be a bit noisy you can increase the threshold to
	  to lower the amounts of input events. Set to 0 for no filtering

endif # INPUT_SBUS
```

## drivers/led_strip/Kconfig.sk9822
```kconfig
#
# Copyright (c) 2024 CogniPilot Foundation.
#
# SPDX-License-Identifier: Apache-2.0
#

config SK9822_STRIP
	bool "SK9822 SPI LED strip driver"
	default y
	depends on DT_HAS_OPSCO_SK9822_ENABLED
	select SPI if $(dt_compat_on_bus,$(DT_COMPAT_OPSCO_SK9822),spi)
	select LED_STRIP_RGB_SCRATCH
	help
	  Enable the LED strip driver for a chain of SK9822 RGB LEDs.
	  These are sold as DotStar by Adafruit and SK9822 by others.
```

## drivers/mdio/Kconfig.nxp_s32_gmac
```kconfig
# Copyright 2023 NXP
# SPDX-License-Identifier: Apache-2.0

menuconfig MDIO_NXP_S32_GMAC
	bool "NXP S32 GMAC MDIO driver"
	default y
	depends on DT_HAS_NXP_S32_GMAC_MDIO_ENABLED
	depends on CLOCK_CONTROL
	select NOCACHE_MEMORY
	help
	  Enable GMAC MDIO driver for NXP S32 SoCs.

if MDIO_NXP_S32_GMAC

config MDIO_NXP_S32_TIMEOUT
	int "Timeout for read/write operations in milliseconds"
	default 2
	help
	  Timeout (in milliseconds) for read/write operations over MDIO.

endif # MDIO_NXP_S32_GMAC
```

## drivers/pwm/Kconfig.mcux_gpt
```kconfig
# Copyright 2024 NXP
# SPDX-License-Identifier: Apache-2.0

config PWM_MCUX_GPT
	bool "MCUX GPT PWM driver"
	default y
	depends on DT_HAS_NXP_GPT_PWM_ENABLED
	depends on CLOCK_CONTROL && PINCTRL
	help
	  Enable gpt based pwm driver.
```

## drivers/sensor/pixart/Kconfig
```kconfig
# zephyr-keep-sorted-start
source "drivers/sensor/pixart/paa3905/Kconfig"
source "drivers/sensor/pixart/pat9136/Kconfig"
# zephyr-keep-sorted-stop
```

## drivers/sensor/pixart/pat9136/Kconfig
```kconfig
# Copyright (c) 2025 Croxel Inc.
# SPDX-License-Identifier: Apache-2.0

config PAT9136
	bool "Optical Flow Sensor PAT9136"
	help
	  Enable driver for PAT9136 Optical Flow sensor.
```

## dts/bindings/input/futaba,sbus.yaml
```yaml
# Copyright (c) 2024 NXP Semiconductors
# SPDX-License-Identifier: Apache-2.0

description: |
  SBUS input driver using
  This driver implements the SBUS protocol used in RC radio
  to send out analogue joystick and switches output.
  The driver binds this to the Zephyr input system using INPUT_EV_CODES

  The following examples defines a a binding of 2 joysticks using 4 channels

  &gpt5 {
    compatible = "sbus";
    pinctrl-0 = <&pinmux_gpt_ppm>;
    pinctrl-names = "default";
    capture-channel = <1>;
    right_stick_x {
      channel = <1>;
      label = "Right stick x";
      type = <INPUT_EV_ABS>;
      zephyr,code = <INPUT_ABS_RX>;
    };
    right_stick_y {
      channel = <2>;
      label = "Right stick y";
      type = <INPUT_EV_ABS>;
      zephyr,code = <INPUT_ABS_RY>;
    };
    left_stick_x {
      channel = <3>;
      label = "Left stick x";
      type = <INPUT_EV_ABS>;
      zephyr,code = <INPUT_ABS_X>;
    };
    left_stick_y {
      channel = <4>;
      label = "Left stick y";
      type = <INPUT_EV_ABS>;
      zephyr,code = <INPUT_ABS_Y>;
    };
  };

compatible: "futaba,sbus"

include: [base.yaml, uart-device.yaml]

child-binding:
  description: PPM Channel to input-event-code binding
  properties:
    channel:
      type: int
      required: true
      description: PPM input channel
    label:
      type: string
      description: Descriptive name of the key
    type:
      type: int
      required: true
      description: Input event types see INPUT_EV_CODES
    zephyr,code:
      type: int
      required: true
      description: Code to emit.
```

## dts/bindings/led_strip/opsco,sk9822.yaml
```yaml
description: SK9822 SPI LED strip

compatible: "opsco,sk9822"

include: spi-device.yaml
```

## dts/bindings/misc/nxp,flexio-dshot.yaml
```yaml
# Copyright 2024 NXP
# SPDX-License-Identifier: Apache-2.0

description: NXP Flexio DSHOT controller.
  Each flexio timer can be used for generating one dshot pulse.
  The two DSHOT modes supported by flexio are chosen based on the selected polarity -
  Dual 8-bit counters DSHOT mode and Dual 8-bit counters DSHOT Low mode.

compatible: "nxp,flexio-dshot"

include: [pinctrl-device.yaml, base.yaml]

properties:
  pinctrl-0:
    required: true

  pinctrl-names:
    required: true

child-binding:
  description: |
    Flexio DSHOT channel configuration.

  properties:
    pin-id:
      type: int
      required: true
      description: |
        pin-id should be populated with number 'n' specified in the
        FXIO_D<n> data pin of your board's schematic.
```

## dts/bindings/pwm/nxp,gpt-pwm.yaml
```yaml
# Copyright (c) 2024, NXP
# SPDX-License-Identifier: Apache-2.0

description: NXP GPT PWM

compatible: "nxp,gpt-pwm"

include: [pwm-controller.yaml, pinctrl-device.yaml, base.yaml]

properties:
  prescaler:
    type: int
    default: 1
    description: prescaling factor from the GPT clock. Default to 1 which is the reset value

  gptfreq:
    type: int
    required: true
    description: gpt frequences

  "#pwm-cells":
    const: 3

pwm-cells:
  - channel
  - period
  - flags
```
