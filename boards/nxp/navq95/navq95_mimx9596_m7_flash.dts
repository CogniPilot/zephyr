/*
 * Copyright 2024 NXP
 *
 * SPDX-License-Identifier: Apache-2.0
 */

/dts-v1/;

#include "navq95_mimx9596_m7.dts"

/ {
	model = "NXP NavQ95 NOR flash variant";

	chosen {
		zephyr,flash = &mx25um51345g;
		zephyr,code-partition = &slot0_partition;
	};
};
