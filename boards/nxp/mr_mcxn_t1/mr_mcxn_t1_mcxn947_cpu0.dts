/*
 * Copyright 2025 NXP
 *
 * SPDX-License-Identifier: Apache-2.0
 */

/dts-v1/;

#include "mr_mcxn_t1_mcxn947_cpu0.dtsi"

/ {
	model = "NXP MR-MCXN-T1 board";
	compatible = "nxp,mcxn947", "nxp,mcx";
};
